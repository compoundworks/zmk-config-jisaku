## boards/shields/jisaku/Kconfig.defconfig
```kconfig
if SHIELD_JISAKU_RIGHT

config ZMK_KEYBOARD_NAME
    default "Jisaku39"

config ZMK_SPLIT_ROLE_CENTRAL
    default y

endif

if SHIELD_JISAKU_LEFT || SHIELD_JISAKU_RIGHT

config ZMK_SPLIT
    default y

endif
```

## boards/shields/jisaku/Kconfig.shield
```kconfig
config SHIELD_JISAKU_LEFT
    def_bool $(shields_list_contains,jisaku_left)

config SHIELD_JISAKU_RIGHT
    def_bool $(shields_list_contains,jisaku_right)
```

## config/west.yml
```yaml
# ZMK v0.3 (official) + drivers.
# badjeff の2つは te9no/zmk-config-MKB2 (MeKaBu) が v0.3 系で使っている版にそろえた。
manifest:
  remotes:
    - name: zmkfirmware
      url-base: https://github.com/zmkfirmware
    - name: badjeff
      url-base: https://github.com/badjeff
    - name: AYM1607
      url-base: https://github.com/AYM1607
  projects:
    - name: zmk
      remote: zmkfirmware
      revision: v0.3-branch
      import: app/west.yml
    # trackball sensor (right)
    - name: zmk-pmw3610-driver
      remote: badjeff
      revision: 42e0a8557a3adc43231fef4234f23e530034e427
    # analog stick JT8P (left)
    - name: zmk-analog-input-driver
      remote: badjeff
      revision: 2684f22ee7e2168d4393f7e63676912210a796fc
    # trackpad IQS525 (right)
    - name: zmk-driver-azoteq-iqs5xx
      remote: AYM1607
      revision: 27321f0232b50f0af31eb27ff97d539933467ea4
  self:
    path: config
```
